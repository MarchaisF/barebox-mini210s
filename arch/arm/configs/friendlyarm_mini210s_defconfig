## arch/arm/configs/friendlyarm_mini210s_defconfig
```kconfig
CONFIG_ARCH_S5PCxx=y
CONFIG_MACH_MINI210S=y
CONFIG_TEXT_BASE=0x23e00000
# CONFIG_RELOCATABLE is not set
CONFIG_S3C_PLL_INIT=y
CONFIG_CMD_LED=y
CONFIG_CMD_LED_TRIGGER=y
CONFIG_LED=y
CONFIG_LED_GPIO=y
CONFIG_LED_TRIGGERS=y
CONFIG_DEFAULT_ENVIRONMENT=y
CONFIG_DEFAULT_ENVIRONMENT_GENERIC=y
CONFIG_CMD_EXPORT=y
CONFIG_MTD=y
# CONFIG_MTD_WRITE is not set
CONFIG_MTD_OOB_DEVICE=y
CONFIG_MTD_RAW_DEVICE=y
CONFIG_NAND=y
CONFIG_NAND_S5PV210=y
CONFIG_CMD_NAND=y
CONFIG_CMD_CRC=y
CONFIG_CMD_PARTITION=y
CONFIG_NET=y
CONFIG_FS_TFTP=y
CONFIG_CMD_BOOTM=y
CONFIG_CMD_BOOTZ=y
CONFIG_CMD_DHCP=y
CONFIG_CMD_TFTP=y
CONFIG_DRIVER_NET_DM9K=y
```
